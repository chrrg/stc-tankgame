/*
坦克大战
小组成员: xxx xxx xxx

*/
#include "includes.h"
sbit key_Up=P4^0;
sbit key_Down=P3^4;
sbit key_Left=P4^3;
sbit key_Right=P3^3;//跟自带按键一样
sbit key_Attack=P2^6;
sbit key_Enter=P3^2;
sbit key_Back=P2^4;
sbit KEY = P3^3;//自带按键

uchar code authorBox[]={
	0xFF,0xFF,0xFF,0xFF,0xFF,0xFF,0xFF,0xFF,0xFF,0xFF,0xFF,0xFF,0xFF,0xFF,0xFF,0xFF,
	0xFF,0xFF,0xFF,0xFF,0xFF,0xFF,0xFF,0xFF,0xFF,0xFF,0xFF,0xFF,0xFF,0xFF,0xFF,0xFF,
	0xFF,0xFF,0xFF,0xFF,0xFF,0xFF,0xFF,0xFF,0xFF,0xFF,0xFF,0xFF,0xFF,0xFF,0xFF,0xFF,
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	0xFF,0xFF,0xFF,0xFF,0xFF,0xFF,0xFF,0xFF,0xFF,0xFF,0xFF,0xFF,0xFF,0xFF,0xFF,0xFF
};
uchar code infBox[]={
	0xFF,0xFF,0xFF,0xFF,0xFF,0xFF,0xFF,0xFF,0xFF,0xFF,0xFF,0xFF,0xFF,0xFF,0xFF,0xFF,
	0xFF,0xFF,0xFF,0xFF,0xFF,0xFF,0xFF,0xFF,0xFF,0xFF,0xFF,0xFF,0xFF,0xFF,0xFF,0xFF,
	0xFF,0xFF,0xFF,0xFF,0xFF,0xFF,0xFF,0xFF,0xFF,0xFF,0xFF,0xFF,0xFF,0xFF,0xFF,0xFF,
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	0xFF,0xFF,0xFF,0xFF,0xFF,0xFF,0xFF,0xFF,0xFF,0xFF,0xFF,0xFF,0xFF,0xFF,0xFF,0xFF
};
uchar code level1[]={//第一关的地图
	0xFF,0xFF,0xFF,0xFF,0xFF,0xFF,0xFF,0xFF,0xFF,0xFF,0xFF,0xFF,0xFF,0xFF,0xFF,0xFF,
	0xFF,0xFF,0xFF,0xFF,0xFF,0xFF,0xFF,0xFF,0xFF,0xFF,0xFF,0xFF,0xFF,0xFF,0xFF,0xFF,
	0xFF,0xFF,0xFF,0xFF,0xFF,0xFF,0xFF,0xFF,0xFF,0xFF,0xFF,0xFF,0xFF,0xFF,0xFF,0xFF,
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	0xFF,0xFF,0xFF,0xFF,0xFF,0xFF,0xFF,0xFF,0xFF,0xFF,0xFF,0xFF,0xFF,0xFF,0xFF,0xFF
};
uchar code game_over[]={
	0xFF,0xFF,0xFF,0xFF,0xFF,0xFF,0xFF,0xFF,0xFF,0xFF,0xFF,0xFF,0xFF,0xFF,0xFF,0xFF,
	0xFF,0xFF,0xFF,0xFF,0xFF,0xFF,0xFF,0xFF,0xFF,0xFF,0xFF,0xFF,0xFF,0xFF,0xFF,0xFF,
	0xFF,0xFF,0xFF,0xFF,0xFF,0xFF,0xFF,0xFF,0xFF,0xFF,0xFF,0xFF,0xFF,0xFF,0xFF,0xFF,
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	0xFF,0xFF,0xFF,0xFF,0xFF,0xFF,0xFF,0xFF,0xFF,0xFF,0xFF,0xFF,0xFF,0xFF,0xFF,0xFF
};
uchar code game_success[]={
	0xFF,0xFF,0xFF,0xFF,0xFF,0xFF,0xFF,0xFF,0xFF,0xFF,0xFF,0xFF,0xFF,0xFF,0xFF,0xFF,
	0xFF,0xFF,0xFF,0xFF,0xFF,0xFF,0xFF,0xFF,0xFF,0xFF,0xFF,0xFF,0xFF,0xFF,0xFF,0xFF,
	0xFF,0xFF,0xFF,0xFF,0xFF,0xFF,0xFF,0xFF,0xFF,0xFF,0xFF,0xFF,0xFF,0xFF,0xFF,0xFF,
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	0xFF,0xFF,0xFF,0xFF,0xFF,0xFF,0xFF,0xFF,0xFF,0xFF,0xFF,0xFF,0xFF,0xFF,0xFF,0xFF
};
uchar code tank_up[]={0x30,0x30,0xFC,0xFC,0xFC,0xFC};//坦克朝上
uchar code tank_le[]={0x3C,0x3C,0xFC,0xFC,0x3C,0x3C};//坦克向左
uchar code tank_do[]={0xFC,0xFC,0xFC,0xFC,0x30,0x30};//坦克向下
uchar code tank_ri[]={0xF0,0xF0,0xFC,0xFC,0xF0,0xF0};//坦克向右

sbit LED1 = P5^5;
sbit LED2 = P4^2;

unsigned long LevelTime=0;
uchar Level=0,i;
GameCore *game=NULL;//游戏引擎对象
GameObject* gameObject[10];//游戏根元素对象
//GamePic* pic=NULL;
GamePic* gamePic[10];
unsigned long bullet_time=0;//子弹时间
//uint oldSecond=0;
uchar life,score;

Enemy_Tank enemy_tank[4];//敌方坦克

Bullet_Data bullet[MaxTankBullet];//子弹
/*Enemy_Tank enemy_tank1;
Enemy_Tank enemy_tank2;
Enemy_Tank enemy_tank3;
Enemy_Tank enemy_tank4;
*/
uchar getDirection(GameObject* obj){
	if(obj->pic==gamePic[3])return 1;//上
	if(obj->pic==gamePic[4])return 2;//左
	if(obj->pic==gamePic[5])return 3;//下
	if(obj->pic==gamePic[6])return 4;//右
	return 0;
}
void KeyListener() reentrant{
	int i;
	uchar ch;
	if(key_Left==0){
		//LED2=~LED2;
		if(Level==2){
			gameObject[1]->pic=gamePic[4];
			for(i=0;i<6;i++)
				if(getPixelFromGame(game,gameObject[1]->x-1,gameObject[1]->y+i))return;//如果被挡住了说明不能走
			gameObject[1]->x--;
		}
	}
	if(key_Right==0){
		//LED2=~LED2;
		if(Level==2){
			gameObject[1]->pic=gamePic[6];
			for(i=0;i<6;i++)
				if(getPixelFromGame(game,gameObject[1]->x+6,gameObject[1]->y+i))return;
			gameObject[1]->x++;
		}
	}
	if(key_Up==0){
		//LED2=~LED2;
		if(Level==2){
			gameObject[1]->pic=gamePic[3];
			for(i=0;i<6;i++)
				if(getPixelFromGame(game,gameObject[1]->x+i,gameObject[1]->y-1))return;
			gameObject[1]->y--;
		}
	}
	if(key_Down==0){
		//LED2=~LED2;
		if(Level==2){
			gameObject[1]->pic=gamePic[5];
			for(i=0;i<6;i++)
				if(getPixelFromGame(game,gameObject[1]->x+i,gameObject[1]->y+6))return;
			gameObject[1]->y++;
		}
	}
	if(key_Attack==0){
		if(Level==2){
			if(bullet_time>game->time/100-2)return;
			bullet_time=game->time/100;
			i=0;
			for(i=0;i<MaxTankBullet;i++){
				if(bullet[i].status==0){
					ch=getDirection(gameObject[1]);
					bullet[i].status=ch<<4;
					switch(ch){
						case 1:
							bullet[i].x=gameObject[1]->x+2;
							bullet[i].y=gameObject[1]->y-2;
							break;
						case 2:
							bullet[i].x=gameObject[1]->x-2;
							bullet[i].y=gameObject[1]->y+2;
							break;
						case 3:
							bullet[i].x=gameObject[1]->x+2;
							bullet[i].y=gameObject[1]->y+6;
							break;
						case 4:
							bullet[i].x=gameObject[1]->x+6;
							bullet[i].y=gameObject[1]->y+2;
							break;
					}
					break;
				}
			}
		}
		//LED2=~LED2;
	}
	if(key_Enter==0){
		if(Level==1){//开始游戏
			Level=2;
			gameObject[0]->pic=gamePic[2];
			LevelTime=game->time;
			gameObject[1]->pic=gamePic[3];
			gameObject[1]->x=42;
			gameObject[1]->y=54;
			gameObject[1]->isDisplay=1;
			life=2;//初始化两条命
			score=0;//分数清0
			for(i=0;i<4;i++){
				enemy_tank[i].gameObject->pic=gamePic[5];
				enemy_tank[i].gameObject->isDisplay=1;//敌方坦克复活
				enemy_tank[i].bullet_time=0;
			}
			enemy_tank[0].gameObject->x= 4;enemy_tank[0].gameObject->y=4;
			enemy_tank[1].gameObject->x= 36;enemy_tank[1].gameObject->y=4;
			enemy_tank[2].gameObject->x= 64;enemy_tank[2].gameObject->y=4;
			enemy_tank[3].gameObject->x= 87;enemy_tank[3].gameObject->y=4;
			for(i=0;i<MaxTankBullet;i++)bullet[i].status=0;
		}
		//LED2=~LED2;
	}
	if(key_Back==0){
		//if(Level==1||Level==2){
			gameObject[0]->pic=gamePic[0];
			LevelTime=game->time;
			Level=0;
			gameObject[1]->isDisplay=0;
			for(i=0;i<4;i++)
				enemy_tank[i].gameObject->isDisplay=0;
		//}
		//LED2=~LED2;
	}
}


void initSource(){
	//陈淞 3172052051601 陈双发 3172052051639
	gamePic[0]=newGamePic(&authorBox,128,64);//生成纹理 首屏 作者
	gamePic[1]=newGamePic(&infBox,128,64);//生成纹理 首屏 信息
	gamePic[2]=newGamePic(&level1,128,64);//生成纹理 首屏 地图
	gamePic[3]=newGamePic(&tank_up,6,6);//生成纹理 坦克模型
	gamePic[4]=newGamePic(&tank_le,6,6);//生成纹理 坦克模型
	gamePic[5]=newGamePic(&tank_do,6,6);//生成纹理 坦克模型
	gamePic[6]=newGamePic(&tank_ri,6,6);//生成纹理 坦克模型
	gamePic[7]=newGamePic(&game_over,128,64);//游戏失败
	gamePic[8]=newGamePic(&game_success,128,64);//游戏胜利
}
void beforeDraw() reentrant{//画之前
	
}
uchar bulletIsAttackEnemy(Bullet_Data* bullet) reentrant{//子弹是否击中敌人 击中就返回编号
	uint i;
	for(i=0;i<4;i++){
		if(enemy_tank[i].gameObject->isDisplay&&bullet->x>=enemy_tank[i].gameObject->x && bullet->x<enemy_tank[i].gameObject->x+6 && bullet->y>=enemy_tank[i].gameObject->y && bullet->y<enemy_tank[i].gameObject->y+6)return i;
		if(enemy_tank[i].gameObject->isDisplay&&bullet->x+1>=enemy_tank[i].gameObject->x && bullet->x+1<enemy_tank[i].gameObject->x+6 && bullet->y>=enemy_tank[i].gameObject->y && bullet->y<enemy_tank[i].gameObject->y+6)return i;
		if(enemy_tank[i].gameObject->isDisplay&&bullet->x+1>=enemy_tank[i].gameObject->x && bullet->x+1<enemy_tank[i].gameObject->x+6 && bullet->y+1>=enemy_tank[i].gameObject->y && bullet->y+1<enemy_tank[i].gameObject->y+6)return i;
		if(enemy_tank[i].gameObject->isDisplay&&bullet->x>=enemy_tank[i].gameObject->x && bullet->x<enemy_tank[i].gameObject->x+6 && bullet->y+1>=enemy_tank[i].gameObject->y && bullet->y+1<enemy_tank[i].gameObject->y+6)return i;
	}
	return 99;//99代表没有击中
}
boolean bulletIsAttackMe(Bullet_Data* bullet) reentrant{//子弹是否击中自己 击中就返回true
	if(gameObject[1]->isDisplay&&bullet->x>=gameObject[1]->x && bullet->x<gameObject[1]->x+6 && bullet->y>=gameObject[1]->y && bullet->y<gameObject[1]->y+6)return true;
	if(gameObject[1]->isDisplay&&bullet->x+1>=gameObject[1]->x && bullet->x+1<gameObject[1]->x+6 && bullet->y>=gameObject[1]->y && bullet->y<gameObject[1]->y+6)return true;
	if(gameObject[1]->isDisplay&&bullet->x+1>=gameObject[1]->x && bullet->x+1<gameObject[1]->x+6 && bullet->y+1>=gameObject[1]->y && bullet->y+1<gameObject[1]->y+6)return true;
	if(gameObject[1]->isDisplay&&bullet->x>=gameObject[1]->x && bullet->x<gameObject[1]->x+6 && bullet->y+1>=gameObject[1]->y && bullet->y+1<gameObject[1]->y+6)return true;
	return false;//99代表没有击中
}
void letgameover() reentrant{
	Level=3;
	gameObject[0]->pic=gamePic[7];
	LevelTime=game->time;
	gameObject[1]->isDisplay=0;
	for(i=0;i<4;i++)
		enemy_tank[i].gameObject->isDisplay=0;
}
void letgamesuccess() reentrant{
	Level=4;
	gameObject[0]->pic=gamePic[8];
	LevelTime=game->time;
	gameObject[1]->isDisplay=0;
	for(i=0;i<4;i++)
		enemy_tank[i].gameObject->isDisplay=0;
}
void afterDraw() reentrant{
	uint i,j,k;
	uchar direction;
	if(Level==2){
		drawNumber(game,game->fps,116,5);
		drawNumber(game,(game->time-LevelTime)/100,106,15);
		drawNumber(game,life,108,26);
		drawNumber(game,score,108,36);
		if(game->time-LevelTime>6000)letgameover();//超过60秒结束游戏！
		for(i=0;i<4;i++){//AI
			if(enemy_tank[i].gameObject->isDisplay==0)continue;//死亡的不用进行AI
			direction=enemy_tank[i].status;
			switch(direction){
				case 1://上
					for(j=0;j<6;j++)
						if(getPixelFromGame(game,enemy_tank[i].gameObject->x+j,enemy_tank[i].gameObject->y-1)){
							enemy_tank[i].status=0;
							break;
						};//如果被挡住了说明不能走
					if(enemy_tank[i].status==0)break;
					enemy_tank[i].gameObject->pic=gamePic[3];	
					enemy_tank[i].gameObject->y--;
					if(rand()%3==0 && enemy_tank[i].bullet_time<game->time/100-2){
						enemy_tank[i].bullet_time=game->time/100;
						for(j=0;j<MaxTankBullet;j++){
							if(bullet[j].status==0){
								bullet[j].status=0x11;//敌方子弹
								bullet[j].x=enemy_tank[i].gameObject->x+2;
								bullet[j].y=enemy_tank[i].gameObject->y-2;
								break;
							}
						}
					}
					if(rand()%5==0)
						enemy_tank[i].status=rand()%5;
					break;
				case 2://左
					for(j=0;j<6;j++)
						if(getPixelFromGame(game,enemy_tank[i].gameObject->x-1,enemy_tank[i].gameObject->y+j)){
							enemy_tank[i].status=0;
							break;
						};//如果被挡住了说明不能走
					if(enemy_tank[i].status==0)break;
					enemy_tank[i].gameObject->pic=gamePic[4];	
					enemy_tank[i].gameObject->x--;
					if(rand()%3==0&&enemy_tank[i].bullet_time<game->time/100-2){
						enemy_tank[i].bullet_time=game->time/100;
						for(j=0;i<MaxTankBullet;j++){
							if(bullet[j].status==0){
								bullet[j].status=0x21;//敌方子弹
								bullet[j].x=enemy_tank[i].gameObject->x+2;
								bullet[j].y=enemy_tank[i].gameObject->y+6;
								break;
							}
						}
					}
					if(rand()%5==0)
						enemy_tank[i].status=rand()%5;
					break;
				case 3://下
					for(j=0;j<6;j++)
						if(getPixelFromGame(game,enemy_tank[i].gameObject->x+j,enemy_tank[i].gameObject->y-1)){
							enemy_tank[i].status=0;
							break;
						};//如果被挡住了说明不能走
					if(enemy_tank[i].status==0)break;
					enemy_tank[i].gameObject->pic=gamePic[5];	
					enemy_tank[i].gameObject->y++;
					if(rand()%3==0&&enemy_tank[i].bullet_time<game->time/100-2){
						enemy_tank[i].bullet_time=game->time/100;
						for(j=0;j<MaxTankBullet;j++){
							if(bullet[j].status==0){
								bullet[j].status=0x31;//敌方子弹
								bullet[j].x=enemy_tank[i].gameObject->x-2;
								bullet[j].y=enemy_tank[i].gameObject->y+2;
								break;
							}
						}
					}
					if(rand()%5==0)
						enemy_tank[i].status=rand()%5;
					break;
				case 4://右
					for(j=0;j<6;j++)
						if(getPixelFromGame(game,enemy_tank[i].gameObject->x+6,enemy_tank[i].gameObject->y+j)){
							enemy_tank[i].status=0;
							break;
						};//如果被挡住了说明不能走
					if(enemy_tank[i].status==0)break;
					enemy_tank[i].gameObject->pic=gamePic[6];	
					enemy_tank[i].gameObject->x++;
					if(rand()%3==0&&enemy_tank[i].bullet_time<game->time/100-2){
						enemy_tank[i].bullet_time=game->time/100;
						for(j=0;j<MaxTankBullet;j++){
							if(bullet[j].status==0){
								bullet[j].status=0x41;//敌方子弹
								bullet[j].x=enemy_tank[i].gameObject->x+6;
								bullet[j].y=enemy_tank[i].gameObject->y+2;
								break;
							}
						}
					}
					if(rand()%5==0)
						enemy_tank[i].status=rand()%5;
					break;
				default:
					if(rand()%5==0)
						enemy_tank[i].status=rand()%5;
			}
			
		}
		for(i=0;i<MaxTankBullet;i++){
			if(bullet[i].status!=0){
				
				drawPixel(game,bullet[i].x,bullet[i].y,1);
				drawPixel(game,bullet[i].x+1,bullet[i].y,1);
				drawPixel(game,bullet[i].x,bullet[i].y+1,1);
				drawPixel(game,bullet[i].x+1,bullet[i].y+1,1);
				direction=bullet[i].status>>4;
				k=bullet[i].status&0xf;
				
				//if(direction==1)LED2=~LED2;
				//continue;
				switch(direction){
					case 1:
						bullet[i].y-=3;
						if(k==0){//己方子弹
							j=bulletIsAttackEnemy(&bullet[i]);
							if(j!=99){
								enemy_tank[j].gameObject->isDisplay=0;
								bullet[i].status=0;
								score+=10;
								if(score>=40)letgamesuccess();
								break;
							}
						}else{
							if(bulletIsAttackMe(&bullet[i])){
								bullet[i].status=0;
								life--;
								if(life==0)letgameover();
								break;
							}
						}
						if(getPixelFromGame(game,bullet[i].x,bullet[i].y)){bullet[i].status=0;break;}
						if(getPixelFromGame(game,bullet[i].x+1,bullet[i].y)){bullet[i].status=0;break;}
						if(getPixelFromGame(game,bullet[i].x,bullet[i].y-1)){bullet[i].status=0;break;}
						if(getPixelFromGame(game,bullet[i].x+1,bullet[i].y-1)){bullet[i].status=0;break;}
						if(getPixelFromGame(game,bullet[i].x,bullet[i].y-2)){bullet[i].status=0;break;}
						if(getPixelFromGame(game,bullet[i].x+1,bullet[i].y-2)){bullet[i].status=0;break;}
						
						
						break;
					case 2:
						bullet[i].x-=3;
						if(k==0){//己方子弹
							j=bulletIsAttackEnemy(&bullet[i]);
							if(j!=99){
								enemy_tank[j].gameObject->isDisplay=0;
								bullet[i].status=0;
								score+=10;
								if(score>=40)letgamesuccess();
								break;
							}
						}else{
							if(bulletIsAttackMe(&bullet[i])){
								bullet[i].status=0;
								life--;
								if(life==0)letgameover();
								break;
							}
						}
						if(getPixelFromGame(game,bullet[i].x,bullet[i].y)){bullet[i].status=0;break;}
						if(getPixelFromGame(game,bullet[i].x+1,bullet[i].y)){bullet[i].status=0;break;}
						if(getPixelFromGame(game,bullet[i].x+2,bullet[i].y)){bullet[i].status=0;break;}
						if(getPixelFromGame(game,bullet[i].x,bullet[i].y+1)){bullet[i].status=0;break;}
						if(getPixelFromGame(game,bullet[i].x+1,bullet[i].y+1)){bullet[i].status=0;break;}
						if(getPixelFromGame(game,bullet[i].x+2,bullet[i].y+1)){bullet[i].status=0;break;}
						break;
					case 3:
						bullet[i].y+=3;
						if(k==0){//己方子弹
							j=bulletIsAttackEnemy(&bullet[i]);
							if(j!=99){
								enemy_tank[j].gameObject->isDisplay=0;
								bullet[i].status=0;
								score+=10;
								if(score>=40)letgamesuccess();
								break;
							}
						}else{
							if(bulletIsAttackMe(&bullet[i])){
								bullet[i].status=0;
								life--;
								if(life==0)letgameover();
								break;
							}
						}
						if(getPixelFromGame(game,bullet[i].x-2,bullet[i].y)){bullet[i].status=0;break;}
						if(getPixelFromGame(game,bullet[i].x-1,bullet[i].y)){bullet[i].status=0;break;}
						if(getPixelFromGame(game,bullet[i].x,bullet[i].y)){bullet[i].status=0;break;}
						if(getPixelFromGame(game,bullet[i].x-2,bullet[i].y+1)){bullet[i].status=0;break;}
						if(getPixelFromGame(game,bullet[i].x-1,bullet[i].y+1)){bullet[i].status=0;break;}
						if(getPixelFromGame(game,bullet[i].x,bullet[i].y+1)){bullet[i].status=0;break;}
						break;
					case 4:
						bullet[i].x+=3;
						if(k==0){//己方子弹
							j=bulletIsAttackEnemy(&bullet[i]);
							if(j!=99){
								enemy_tank[j].gameObject->isDisplay=0;
								bullet[i].status=0;
								score+=10;
								if(score>=40)letgamesuccess();//40分游戏胜利
								break;
							}
						}else{
							if(bulletIsAttackMe(&bullet[i])){
								bullet[i].status=0;
								life--;
								if(life==0)letgameover();
								break;
							}
						}
						if(getPixelFromGame(game,bullet[i].x-1,bullet[i].y)){bullet[i].status=0;break;}
						if(getPixelFromGame(game,bullet[i].x,bullet[i].y)){bullet[i].status=0;break;}
						if(getPixelFromGame(game,bullet[i].x+1,bullet[i].y)){bullet[i].status=0;break;}
						if(getPixelFromGame(game,bullet[i].x-1,bullet[i].y+1)){bullet[i].status=0;break;}
						if(getPixelFromGame(game,bullet[i].x,bullet[i].y+1)){bullet[i].status=0;break;}
						if(getPixelFromGame(game,bullet[i].x+1,bullet[i].y+1)){bullet[i].status=0;break;}
						break;
				}
			}
		}
		
		
	}
}
void TankGame_Init(){
	initGameCore();//初始化游戏引擎
	initSource();//初始化游戏内资源
	game=newGameCore(128,64);//实例化一个游戏引擎 宽128 高64
	
	gameObject[0]=newGameObject();//实例化一个游戏对象
	game->rootGameObject=gameObject[0];//设置根元素到游戏中
	//setRootGameObject(game,gameObject[0]);//设置根元素到游戏中
	//setGamePicOnGameObject(gamePic[0],gameObject[0]);//将纹理绑定到游戏对象中
	gameObject[0]->pic=gamePic[0];
	
	gameObject[1]=newGameObject();//己方坦克
	gameObject[1]->isDisplay=0;//初始化的时候先隐藏
	
	appendChild(gameObject[0],gameObject[1]);
	//enemy_tank1.gameObject=newGameObject();
	//appendChild(gameObject[0],enemy_tank1.gameObject);
	for(i=0;i<4;i++){
		enemy_tank[i].gameObject=newGameObject();
		enemy_tank[i].gameObject->isDisplay=0;
		appendChild(gameObject[0],enemy_tank[i].gameObject);
		
		/*enemy_tank[i]=(Enemy_Tank *)mem_calloc(sizeof(Enemy_Tank));
		enemy_tank[i]->gameObject=newGameObject();
		enemy_tank[i]->gameObject->isDisplay=0;
		appendChild(gameObject[0],enemy_tank[i]->gameObject);*/
	}
	//gameObject[4]=newGameObject();//实例化一个游戏对象 作者框
	
	
	/*
	gameObject[1]=newGameObject();//实例化一个作者对象1
	gameObject[2]=newGameObject();//实例化一个作者对象2
	setGamePicOnGameObject(gamePic[5],gameObject[1]);//贴图
	setGamePicOnGameObject(gamePic[6],gameObject[2]);//贴图
	setGameObjectPos(gameObject[1],13,10);
	setGameObjectPos(gameObject[2],1,30);
	appendChild(gameObject[4],gameObject[1]);//放到作者框元素下
	appendChild(gameObject[4],gameObject[2]);//放到作者框下
	
	gameObject[5]=newGameObject();//游戏进入界面
	*/
	game->beforeDrawCallback=beforeDraw;
	game->afterDrawCallback=afterDraw;
	//gameObject[3]=newGameObject();//实例化一个坦克
	//setGameObjectPos(gameObject[3],30,30);
	//setGamePicOnGameObject(gamePic[1],gameObject[3]);
	//appendChild(gameObject[0],gameObject[3]);
	
	//addCallBack(game,KeyListener);
	
}
GameCore* getGame(){//得到游戏内核 供其他文件调用
	return game;
}
void TankGame_Render(){
	doGameRender(game);
}

void TankGame_Input(unsigned long curTime) reentrant{
	//int i;
	if(game==NULL)return;
	game->time=curTime;
	//gameObject[4]->isDisplay=0;
	//gameObject[4]->isDisplay=1;
	//if(curTime%5000>2500){
	KeyListener();
	
	switch(Level){
		case 0:
			if(curTime>LevelTime+100){//1秒后
				Level=1;
				gameObject[0]->pic=gamePic[1];
				//setGamePicOnGameObject(,);
				//doGameFullRender(game);
				//gameObject[4]->isDisplay=false;//隐藏作者框
				//显示游戏界面
				
			}
			break;
		case 1://显示游戏界面
			
			break;
		case 2:
			break;
		case 3:
			break;
		case 4:
			break;
	}
	//}
		//gameObject[4]->isDisplay=1;
		//gameObject[4]->isDisplay=false;
		//setDisplay(gameObject[4],false);
	//}else{
		//gameObject[4]->isDisplay=1;
		//setDisplay(gameObject[4],true);
	//}
	//doCallback(game);
	/*if(KEY==0){
		OSTimeDly(OS_TICKS_PER_SEC/100);
		if(KEY==0){
			LED1=0;
			LED2=0;
		}
	}else{
		LED1=1;LED2=1;	 
	}*/
}
void TankGame_Destroy(){
	DestroyGameCore(game);
}